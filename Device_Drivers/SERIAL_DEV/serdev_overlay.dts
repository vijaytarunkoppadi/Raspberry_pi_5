/dts-v1/;
/plugin/;
/ {
        compatible = "bcrm,bcm2712";
        fragment@0{
                target = <&uart0>;
                __overlay__{
                        echodev{
                                compatible = "brightlight,echodev";
                                status  = "okay";
                        };
                };
        };
  };
